## firmware/gateway/main/Kconfig.projbuild
```kconfig
menu "Veto gateway"
    config GW_UP_SSID
        string "Upstream Wi-Fi SSID (the Pi)"
        default "bigp-lab"
    config GW_UP_PASS
        string "Upstream Wi-Fi password"
        default ""
    config GW_UP_IP
        string "Static IP on the upstream network"
        default "192.168.77.2"
    config GW_UP_GW
        string "Upstream gateway (the Pi)"
        default "192.168.77.1"
    config GW_AP_SSID
        string "IoT Wi-Fi SSID served by the gateway"
        default "bigp-iot"
    config GW_AP_PASS
        string "IoT Wi-Fi password (8+ characters)"
        default ""
    config GW_CHANNEL
        int "Wi-Fi channel (must equal the upstream AP's)"
        default 6
    choice GW_MODEL
        prompt "Model"
        default GW_MODEL_TRANSFER
        config GW_MODEL_TRANSFER
            bool "B-transfer (paper recipe, trained on CTU-13)"
        config GW_MODEL_LAB
            bool "B-lab (same recipe, trained on lab traffic)"
    endchoice
    config GW_ORDINARY
        bool "Ordinary IPS: block on every alarm (comparison mode, no certificate)"
        default n
    config GW_MONITOR
        bool "Monitor only: score and log every flow, never block (benign calibration runs)"
        default n
    config GW_TAU
        string "Lab threshold tau_lab (empty = the model's own tau)"
        default ""
    config GW_BLOCK_TTL_S
        int "Block duration (s)"
        default 300
    config GW_HOSTS
        int "Host-context table slots (power of two)"
        default 32
endmenu
```

## firmware/gateway/sdkconfig.defaults
```kconfig
CONFIG_ESPTOOLPY_FLASHSIZE_4MB=y
CONFIG_ESP_DEFAULT_CPU_FREQ_MHZ_240=y
CONFIG_COMPILER_OPTIMIZATION_PERF=y
CONFIG_LWIP_IP_FORWARD=y
CONFIG_LWIP_IPV4_NAPT=n
CONFIG_ESP_CONSOLE_UART_CUSTOM=y
CONFIG_ESP_CONSOLE_UART_BAUDRATE=921600
CONFIG_ESP_MAIN_TASK_STACK_SIZE=8192
CONFIG_LOG_DEFAULT_LEVEL_WARN=y
CONFIG_LWIP_L2_TO_L3_COPY=y
```

## firmware/sensor/main/Kconfig.projbuild
```kconfig
menu "OnePass sensor"
    config OP_WIFI_SSID
        string "Wi-Fi SSID"
        default "bigp-lab"
    config OP_WIFI_PASS
        string "Wi-Fi password"
        default ""
    config OP_BROKER_URI
        string "MQTT broker URI"
        default "mqtt://192.168.77.1:1883"
    config OP_MQTT_USER
        string "MQTT username"
        default "esp32sensor"
    config OP_MQTT_PASS
        string "MQTT password"
        default ""
    config OP_PERIOD_MS
        int "Publish period (ms)"
        default 5000
endmenu
```
